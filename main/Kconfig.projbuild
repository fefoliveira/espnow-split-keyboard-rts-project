## main/Kconfig.projbuild
```kconfig
menu "Keyboard Configuration"

    choice KEYBOARD_TARGET_DEVICE
        prompt "Target Device"
        default KEYBOARD_HALF_LEFT
        help
            Select which split-keyboard half this firmware image targets.

        config KEYBOARD_HALF_LEFT
            bool "Left Half (ESP1)"

        config KEYBOARD_HALF_RIGHT
            bool "Right Half (ESP2)"
    endchoice

    choice KEYBOARD_OUTPUT_MODE
        prompt "Right node output mode"
        default KEYBOARD_OUTPUT_BLE_HID
        help
            Select how the right node emits the consolidated keyboard state.

        config KEYBOARD_OUTPUT_BLE_HID
            bool "Bluetooth BLE HID keyboard"

        config KEYBOARD_OUTPUT_SERIAL
            bool "Serial log bridge"
    endchoice

endmenu
```

## sdkconfig.defaults.esp1
```kconfig
CONFIG_KEYBOARD_HALF_LEFT=y
# CONFIG_KEYBOARD_HALF_RIGHT is not set
CONFIG_KEYBOARD_OUTPUT_SERIAL=y
# CONFIG_KEYBOARD_OUTPUT_BLE_HID is not set
CONFIG_FREERTOS_HZ=1000
```

## sdkconfig.defaults.esp2
```kconfig
# CONFIG_KEYBOARD_HALF_LEFT is not set
CONFIG_KEYBOARD_HALF_RIGHT=y
# CONFIG_KEYBOARD_OUTPUT_SERIAL is not set
CONFIG_KEYBOARD_OUTPUT_BLE_HID=y
CONFIG_FREERTOS_HZ=1000
CONFIG_BT_ENABLED=y
CONFIG_BT_BLUEDROID_ENABLED=y
CONFIG_BT_BLE_ENABLED=y
CONFIG_BT_HID_ENABLED=y
CONFIG_BT_BLE_42_FEATURES_SUPPORTED=y
CONFIG_PARTITION_TABLE_SINGLE_APP_LARGE=y
```
